## br2_external/Config.in
```kconfig
source "$BR2_EXTERNAL_X6200_PATH/package/aether-x6200-control/Config.in"
source "$BR2_EXTERNAL_X6200_PATH/package/x6200-gui/Config.in"
source "$BR2_EXTERNAL_X6200_PATH/package/rhvoice/Config.in"
source "$BR2_EXTERNAL_X6200_PATH/package/ft8lib/Config.in"
source "$BR2_EXTERNAL_X6200_PATH/package/x6100-webserver/Config.in"
source "$BR2_EXTERNAL_X6200_PATH/package/python-bottle-sqlite/Config.in"
source "$BR2_EXTERNAL_X6200_PATH/package/rtw88/Config.in"
```

## br2_external/package/rtw88/Config.in
```kconfig
config BR2_PACKAGE_RTW88
	bool "rtw88"
	depends on BR2_LINUX_KERNEL
	help
	  rtw88 WiFi linux driver
```

## br2_external/package/x6200-gui/Config.in
```kconfig
config BR2_PACKAGE_X6200_GUI
	bool "x6200_gui"
	select BR2_PACKAGE_LIBPNG
	select BR2_PACKAGE_AETHER_X6200_CONTROL
	select BR2_PACKAGE_SPEEXDSP
	select BR2_PACKAGE_LIQUID_DSP
	select BR2_PACKAGE_FT8LIB
	help
	  X6200 GUI application

	  TTS (RHVoice) and GPS (gpsd) were removed for power savings,
	  see docs/TRD.md.
```
